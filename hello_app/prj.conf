## CMakeLists.txt
```
cmake_minimum_required(VERSION 3.20.0)

find_package(Zephyr REQUIRED HINTS $ENV{ZEPHYR_BASE})

project(
  hello_app
  VERSION 1.0.0
  LANGUAGES C)

target_sources(app PRIVATE src/main.c src/app_logic.c)
```

## west.yml
```
# West manifest for zephyr-appsec-lab
#
# Option A: Plain Zephyr (no sdk-nrf).
# The nRF5340DK board is fully supported in upstream Zephyr.
# sdk-nrf is only needed for Nordic-specific features (BLE stack, modem, etc.)
# which this AppSec demo does not use.
#
# SBOM-relevant software (pinned versions):
#   - Zephyr RTOS  v3.2.0  (zephyrproject-rtos/zephyr)
#
# All west module SHAs are pinned via Zephyr's own manifest import.

manifest:
  version: "0.10"

  remotes:
    - name: zephyrproject
      url-base: https://github.com/zephyrproject-rtos

  projects:
    - name: zephyr
      remote: zephyrproject
      revision: v3.2.0
      import: true   # pulls all Zephyr modules automatically

  self:
    path: hello_app
```

## prj.conf
```kconfig
# General application configuration
CONFIG_PRINTK=y

# Logging disabled for minimal hello-world footprint
CONFIG_LOG=n
```

## boards/nrf5340dk_nrf5340_cpuapp.conf
```kconfig
# Board-specific configuration for nRF5340 DK (application core)
# u-blox NORA-B106 is based on the nRF5340 SoC (dual-core ARM Cortex-M33)
CONFIG_UART_CONSOLE=y
CONFIG_SERIAL=y
```

## src/main.c
```c
#include "app_logic.h"
#include <zephyr/kernel.h>
#include <zephyr/sys/printk.h>

int main(void)
{
	printk("Hello, Zephyr!\n");
	printk("Board:       %s\n", app_board_name());
	printk("Zephyr RTOS v3.2.0\n");

	while (1) {
		k_sleep(K_SECONDS(1));
		printk("tick\n");
	}

	return 0;
}
```

## src/app_logic.c
```c
#include "app_logic.h"
#include <zephyr/kernel.h>

int validate_input(int val)
{
	return (val >= 0 && val < 100) ? 0 : -1;
}

const char *app_board_name(void)
{
	return CONFIG_BOARD;
}
```

## src/app_logic.h
```c
#ifndef HELLO_APP_SRC_APP_LOGIC_H_
#define HELLO_APP_SRC_APP_LOGIC_H_

/**
 * Validate an input value.
 *
 * @param val Input value to check.
 * @return 0 if valid (0 <= val < 100), -1 otherwise.
 */
int validate_input(int val);

/**
 * Return the board name string.
 *
 * @return CONFIG_BOARD string.
 */
const char *app_board_name(void);

#endif // HELLO_APP_SRC_APP_LOGIC_H_
```

## src/demo_bugs.c
```c
/**
 * demo_bugs.c — Intentional cppcheck findings for lab demonstration.
 *
 * This file is NOT compiled into the firmware (excluded from CMakeLists.txt).
 * It exists solely to produce visible cppcheck findings in the SAST stage,
 * demonstrating that the tool is active and working.
 *
 * Findings expected:
 *   1. bufferAccessOutOfBounds — write past end of fixed-size array
 *   2. nullPointerDereference  — pointer returned by malloc() used without
 *                                NULL check
 *   3. memleak                 — heap allocation never freed
 *
 * Fix for each: see inline comments.
 */

#include <stdlib.h>
#include <string.h>

/* ── Finding 1: Buffer overrun ──────────────────────────────────────────────
 * buf has 8 bytes. The loop writes 9 bytes (indices 0..8).
 * Fix: change loop bound to i < 8, or increase buf size to 9.
 */
void demo_buffer_overrun(void)
{
	char buf[8];

	for (int i = 0; i <= 8; i++) { /* off-by-one: writes buf[8] */
		buf[i] = (char)i;
	}

	(void)buf;
}

/* ── Finding 2: Null pointer dereference + Finding 3: Memory leak ───────────
 * malloc() can return NULL. Dereferencing without a NULL check is UB.
 * The allocated buffer is also never freed — memory leak.
 * Fix: check ptr != NULL before use; call free(ptr) before returning.
 */
void demo_null_deref_and_leak(void)
{
	char *ptr = (char *)malloc(64);

	/* cppcheck: nullPointerDereference — ptr may be NULL */
	memset(ptr, 0, 64);

	/* cppcheck: memleak — ptr is never freed */
}
```
